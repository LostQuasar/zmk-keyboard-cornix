## boards/shields/cornix_dongle/Kconfig.shield
```kconfig
# No whitespace after the comma or in the keyboard name!
config SHIELD_CORNIX_DONGLE
    def_bool $(shields_list_contains,cornix_dongle)
```

## config/west.yml
```yaml
manifest:
  defaults:
    revision: main
  remotes:
    - name: zmkfirmware
      url-base: https://github.com/zmkfirmware
    - name: LostQuasar
      url-base: https://github.com/LostQuasar
  projects:
    - name: zmk
      remote: zmkfirmware
      import: app/west.yml
    - name: zmk-component-adafruit-sharp
      remote: LostQuasar
  self:
    path: config
```
